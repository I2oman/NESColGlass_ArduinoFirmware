#include <EEPROM.h>
#include <Wire.h>
#include <Adafruit_GFX.h>
#include <Adafruit_SSD1306.h>
#include <SoftwareSerial.h>

SoftwareSerial BTSerial(5, 6);

#define SCREEN_WIDTH 128
#define SCREEN_HEIGHT 64
#define OLED_RESET -1

#define SCREEN_ADDRESS 0x3C  // <- Change this address if it doesn't work

Adafruit_SSD1306 display(SCREEN_WIDTH, SCREEN_HEIGHT, &Wire, OLED_RESET);

#define LOGO_SIZE 32

const unsigned char PROGMEM NESCol_Glass_Logo_128x64[] = {
  0x00, 0x00, 0x00, 0x3f, 0xc0, 0x00, 0x00, 0x00, 0x00, 0x00, 0x00, 0x00, 0x00, 0x00, 0x00, 0x00,
  0x00, 0x00, 0x00, 0x07, 0xff, 0xff, 0xff, 0x70, 0x00, 0x00, 0x00, 0x00, 0x00, 0x00, 0x00, 0x00,
  0x00, 0x00, 0x00, 0x00, 0x7f, 0xff, 0xff, 0xff, 0xff, 0xff, 0xb0, 0x00, 0x00, 0x00, 0x00, 0x00,
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  0x00, 0x00, 0x00, 0x00, 0x00, 0x00, 0x00, 0x0f, 0x80, 0x00, 0x00, 0x00, 0x00, 0x00, 0x00, 0x00
};
const unsigned char PROGMEM tg_logo_32x32[] = {
  0x00, 0x0f, 0xf0, 0x00, 0x00, 0x3f, 0xfc, 0x00, 0x00, 0xff, 0xff, 0x00, 0x03, 0xff, 0xff, 0xc0,
  0x07, 0xff, 0xff, 0xe0, 0x0f, 0xff, 0xff, 0xf0, 0x1f, 0xff, 0xff, 0xf8, 0x1f, 0xff, 0xff, 0xf8,
  0x3f, 0xff, 0xff, 0xfc, 0x3f, 0xff, 0xf8, 0xfc, 0x7f, 0xff, 0xe0, 0xfe, 0x7f, 0xff, 0x80, 0xfe,
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  0x03, 0xff, 0xff, 0xc0, 0x00, 0xff, 0xff, 0x00, 0x00, 0x3f, 0xfc, 0x00, 0x00, 0x0f, 0xf0, 0x00
};
static const unsigned char PROGMEM whatsApp_logo_32x32[] = {
  0x00, 0x0f, 0xf0, 0x00, 0x00, 0x3f, 0xfc, 0x00, 0x00, 0xff, 0xff, 0x00, 0x03, 0xff, 0xff, 0xc0,
  0x07, 0xf8, 0x1f, 0xe0, 0x0f, 0xe0, 0x07, 0xf0, 0x1f, 0x80, 0x01, 0xf8, 0x1f, 0x07, 0xe0, 0xf8,
  0x3e, 0x1f, 0xf8, 0x7c, 0x3c, 0x3f, 0xfc, 0x3c, 0x7c, 0x73, 0xfe, 0x3e, 0x78, 0xe1, 0xff, 0x1e,
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  0x03, 0xff, 0xff, 0xc0, 0x00, 0xff, 0xff, 0x00, 0x00, 0x3f, 0xfc, 0x00, 0x00, 0x0f, 0xf0, 0x00
};
static const unsigned char PROGMEM teams_logo_32x32[] = {
  0x00, 0x0f, 0xf0, 0x00, 0x00, 0x3f, 0xfc, 0x00, 0x00, 0xff, 0xff, 0x00, 0x03, 0xff, 0xff, 0xc0,
  0x07, 0xff, 0xff, 0xe0, 0x0f, 0xff, 0xff, 0xf0, 0x1f, 0xff, 0xff, 0xf8, 0x1f, 0xfe, 0x3f, 0xf8,
  0x3f, 0xfc, 0x1f, 0x3c, 0x3f, 0xfc, 0x1e, 0x1c, 0x7f, 0xfc, 0x1e, 0x1e, 0x78, 0x02, 0x3f, 0x3e,
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  0x03, 0xff, 0xff, 0xc0, 0x00, 0xff, 0xff, 0x00, 0x00, 0x3f, 0xfc, 0x00, 0x00, 0x0f, 0xf0, 0x00
};
static const unsigned char PROGMEM gmail_logo_32x32[] = {
  0x00, 0x0f, 0xf0, 0x00, 0x00, 0x3f, 0xfc, 0x00, 0x00, 0xff, 0xff, 0x00, 0x03, 0xff, 0xff, 0xc0,
  0x07, 0xff, 0xff, 0xe0, 0x0f, 0xff, 0xff, 0xf0, 0x1f, 0xff, 0xff, 0xf8, 0x1f, 0xff, 0xff, 0xf8,
  0x38, 0xff, 0xff, 0x1c, 0x38, 0x7f, 0xfe, 0x1c, 0x78, 0x1f, 0xf8, 0x1e, 0x78, 0x0f, 0xf0, 0x1e,
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  0x03, 0xff, 0xff, 0xc0, 0x00, 0xff, 0xff, 0x00, 0x00, 0x3f, 0xfc, 0x00, 0x00, 0x0f, 0xf0, 0x00
};
static const unsigned char PROGMEM outlook_logo_32x32[] = {
  0x00, 0x0f, 0xf0, 0x00, 0x00, 0x3f, 0xfc, 0x00, 0x00, 0xff, 0xff, 0x00, 0x03, 0xff, 0xff, 0xc0,
  0x07, 0xff, 0xff, 0xe0, 0x0f, 0xe0, 0x00, 0x70, 0x1f, 0xe0, 0x00, 0x78, 0x1f, 0xc0, 0x00, 0x38,
  0x3f, 0xc0, 0x00, 0x3c, 0x3f, 0xfc, 0x00, 0x3c, 0x78, 0x02, 0x00, 0x3e, 0x70, 0x02, 0x00, 0x3e,
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  0x03, 0xff, 0xff, 0xc0, 0x00, 0xff, 0xff, 0x00, 0x00, 0x3f, 0xfc, 0x00, 0x00, 0x0f, 0xf0, 0x00
};
const unsigned char PROGMEM instagram_logo_32x32[] = {
  0x00, 0x0f, 0xf0, 0x00, 0x00, 0x3f, 0xfc, 0x00, 0x00, 0xff, 0xff, 0x00, 0x03, 0xff, 0xff, 0xc0,
  0x07, 0xff, 0xff, 0xe0, 0x0f, 0xff, 0xff, 0xf0, 0x1f, 0x00, 0x00, 0xf8, 0x1e, 0x00, 0x00, 0x78,
  0x3c, 0x3f, 0xfc, 0x3c, 0x3c, 0x7f, 0xfa, 0x3c, 0x7c, 0xff, 0xf1, 0x3e, 0x7c, 0xf8, 0x1b, 0x3e,
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  0x03, 0xff, 0xff, 0xc0, 0x01, 0xff, 0xff, 0x00, 0x00, 0x3f, 0xfc, 0x00, 0x00, 0x0f, 0xf0, 0x00
};
const unsigned char PROGMEM messenger_logo_32x32[] = {
  0x00, 0x0f, 0xf0, 0x00, 0x00, 0x3f, 0xfc, 0x00, 0x00, 0xff, 0xff, 0x00, 0x03, 0xff, 0xff, 0xc0,
  0x07, 0xff, 0xff, 0xe0, 0x0f, 0xf0, 0x0f, 0xf0, 0x1f, 0xc0, 0x03, 0xf8, 0x1f, 0x00, 0x00, 0xf8,
  0x3e, 0x00, 0x00, 0x7c, 0x3c, 0x00, 0x00, 0x3c, 0x7c, 0x00, 0x00, 0x3e, 0x78, 0x00, 0x00, 0x1e,
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  0x03, 0xff, 0xff, 0xc0, 0x00, 0xff, 0xff, 0x00, 0x00, 0x3f, 0xfc, 0x00, 0x00, 0x0f, 0xf0, 0x00
};
const unsigned char PROGMEM discord_logo_32x32[] = {
  0x00, 0x0f, 0xf0, 0x00, 0x00, 0x3f, 0xfc, 0x00, 0x00, 0xff, 0xff, 0x00, 0x03, 0xff, 0xff, 0xc0,
  0x07, 0xff, 0xff, 0xe0, 0x0f, 0xff, 0xff, 0xf0, 0x1f, 0xff, 0xff, 0xf8, 0x1f, 0xff, 0xff, 0xf8,
  0x3f, 0xff, 0xff, 0xfc, 0x3f, 0x98, 0x19, 0xfc, 0x7f, 0x20, 0x04, 0xfe, 0x7f, 0x00, 0x00, 0xfe,
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  0x03, 0xff, 0xff, 0xc0, 0x00, 0xff, 0xff, 0x00, 0x00, 0x3f, 0xfc, 0x00, 0x00, 0x0f, 0xf0, 0x00
};
const unsigned char PROGMEM viber_logo_32x32[] = {
  0x00, 0x0f, 0xf0, 0x00, 0x00, 0x3f, 0xfc, 0x00, 0x00, 0xff, 0xff, 0x00, 0x03, 0xff, 0xff, 0xc0,
  0x07, 0x80, 0x01, 0xe0, 0x0f, 0x00, 0x00, 0xf0, 0x1e, 0x3f, 0xfc, 0x78, 0x1c, 0x7f, 0xfe, 0x38,
  0x38, 0xff, 0x1f, 0x1c, 0x31, 0xcf, 0xef, 0x8c, 0x73, 0x87, 0xb7, 0xce, 0x73, 0x83, 0xdb, 0xce,
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  0x03, 0x87, 0xff, 0xc0, 0x01, 0x8f, 0xff, 0x00, 0x00, 0x3f, 0xfc, 0x00, 0x00, 0x0f, 0xf0, 0x00
};
static const unsigned char PROGMEM messages_logo_32x32[] = {
  0x00, 0x0f, 0xf0, 0x00, 0x00, 0x3f, 0xfc, 0x00, 0x00, 0xff, 0xff, 0x00, 0x03, 0xff, 0xff, 0xc0,
  0x07, 0x80, 0x07, 0xe0, 0x0f, 0x00, 0x03, 0xf0, 0x1e, 0x00, 0x01, 0xf8, 0x1c, 0x00, 0x01, 0xf8,
  0x38, 0x3f, 0xff, 0xfc, 0x30, 0x7f, 0xff, 0xfc, 0x70, 0xc0, 0x00, 0x7e, 0x71, 0x80, 0x00, 0x3e,
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  0x03, 0xff, 0xff, 0xc0, 0x00, 0xff, 0xff, 0x00, 0x00, 0x3f, 0xfc, 0x00, 0x00, 0x0f, 0xf0, 0x00
};
static const unsigned char PROGMEM phone_logo_32x32[] = {
  0x00, 0x0f, 0xf0, 0x00, 0x00, 0x3f, 0xfc, 0x00, 0x00, 0xff, 0xff, 0x00, 0x03, 0xff, 0xff, 0xc0,
  0x07, 0xff, 0xff, 0xe0, 0x0f, 0xe7, 0xff, 0xf0, 0x1f, 0x83, 0xff, 0xf8, 0x1f, 0x03, 0xff, 0xf8,
  0x3e, 0x01, 0xff, 0xfc, 0x3e, 0x01, 0xff, 0xfc, 0x7c, 0x01, 0xff, 0xfe, 0x7c, 0x01, 0xff, 0xfe,
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  0x03, 0xff, 0xff, 0xc0, 0x00, 0xff, 0xff, 0x00, 0x00, 0x3f, 0xfc, 0x00, 0x00, 0x0f, 0xf0, 0x00
};
static const unsigned char* const app_logos[] = {
  tg_logo_32x32,
  whatsApp_logo_32x32,
  teams_logo_32x32,
  gmail_logo_32x32,
  outlook_logo_32x32,
  instagram_logo_32x32,
  messenger_logo_32x32,
  discord_logo_32x32,
  viber_logo_32x32,
  messages_logo_32x32,
  phone_logo_32x32
};

bool connected;

uint8_t th;
uint8_t tm;
uint8_t ts;
unsigned long even_seconds_checker;
unsigned long time_resumer;
unsigned long live_time;
bool added;
bool show_time_on_standby;

uint8_t content_type;
bool sh_content;
unsigned long content_timer;

uint16_t NOTIFICATION_TIMEOUT = 60000;
static uint8_t appIndex;
static char title[11];
static bool overlap;

bool st_tm_start;
uint8_t sth;
uint8_t stm;
uint8_t sts;
signed long st_tm_timer;

char input_data[100];
char* value_pointer;

void setup() {
  live_time = millis();
  content_timer = millis() - NOTIFICATION_TIMEOUT;

  Serial.begin(9600);
  Serial.setTimeout(1000);
  BTSerial.begin(9600);
  BTSerial.setTimeout(1000);

  if (!display.begin(SSD1306_SWITCHCAPVCC, SCREEN_ADDRESS)) {
    Serial.println(F("SSD1306 allocation failed"));
    for (;;) {};
  }

  display.clearDisplay();
  display.drawBitmap(0, 0, NESCol_Glass_Logo_128x64, 128, 64, 1);
  display.display();
  delay(2500);
  display.clearDisplay();
  display.display();
}

void loop() {
  if (BTSerial.available()) {
    uint8_t number = BTSerial.readBytesUntil(';', input_data, 100);
    input_data[number] = NULL;

    value_pointer = strchr(input_data, '=');
    *value_pointer = NULL;
    value_pointer++;

    switch (atoi(input_data)) {
      case 0:
        // 0=12:34:34;
        th = atoi(value_pointer);
        tm = atoi(value_pointer + 3);
        ts = atoi(value_pointer + 6);
        connected = 1;
        live_time = millis();
        added = 0;
        break;
      case 1:
        show_time_on_standby = atoi(value_pointer);
        break;
      case 2:
        NOTIFICATION_TIMEOUT = atoi(value_pointer);
        break;
      case 3:
        // 3=3;
        appIndex = atoi(value_pointer);
        break;
      case 4:
        // 6=1;
        overlap = atoi(value_pointer);
        break;
      case 5:
        // 7=Name ...;
        strncpy(title, value_pointer, sizeof(title) - 1);
        title[sizeof(title) - 1] = '\0';
        break;
      case 6:
        // 8=Message context;
        if (content_type != 2 && content_type != 3) {
          content_timer = millis();
          content_type = 1;
          sh_content = 1;
          displayContent();
        }
        break;
      case 7:
        sh_content = 1;
        switch (atoi(value_pointer)) {
          case 1:
            content_type = 2;
            break;
          case 2:
            if (content_type != 3) {
              sth = 0;
              stm = 0;
              sts = 0;
            }
            content_type = 3;
            break;
        }
        displayContent();
        break;
      case 8:
        sth = atoi(value_pointer);
        stm = atoi(value_pointer + 3);
        sts = atoi(value_pointer + 6);
        displayContent();
        break;
      case 9:
        switch (atoi(value_pointer)) {
          case 0:
            st_tm_start = 0;
            time_resumer = millis() - content_timer;
            break;
          case 1:
            st_tm_start = 1;
            sh_content = 1;
            content_timer = millis() - time_resumer;
            break;
          case 2:
            st_tm_start = 0;
            if (content_type == 3) {
              sth = 0;
              stm = 0;
              sts = 0;
            }
            time_resumer = 0;
            break;
          case 3:
            content_type = 0;
            sh_content = 0;
            st_tm_start = 0;
            sth = 0;
            stm = 0;
            sts = 0;
            time_resumer = 0;
            break;
        }
        displayContent();
        break;
    }
  }

  if (millis() - live_time > 16000) {
    connected = 0;

    content_type = 0;
    sh_content = 0;
    st_tm_start = 0;
    sth = 0;
    stm = 0;
    sts = 0;
  }

  if (connected) {
    if (sh_content) {
      switch (content_type) {
        case 1:
          if (millis() - content_timer >= NOTIFICATION_TIMEOUT && millis() - content_timer < NOTIFICATION_TIMEOUT + 250) {
            // if (millis() - content_timer >= NOTIFICATION_TIMEOUT) {
            sh_content = 0;
            display.clearDisplay();
            display.display();
          }
          break;
        case 2:
          if (st_tm_start) {
            if (millis() - content_timer >= 1000) {
              content_timer = millis();
              sts--;
              if (sts == 255) {
                sts = 59;
                stm--;
                if (stm == 255) {
                  stm = 59;
                  sth--;
                  if (sth == 255) {
                    sts = 0;
                    stm = 0;
                    sth = 0;
                    st_tm_start = 0;
                  }
                }
              }
            }
            displayContent();
          } else {
            if (millis() - content_timer < 5250 && (sth == 0 && stm == 0 && sts == 0)) {
              even_seconds_checker = (millis() - live_time) / 1000;
              if (even_seconds_checker % 2 == 0) {
                display.clearDisplay();
                display.setCursor(29, 9);
                display.setTextSize(3);
                display.setTextColor(SSD1306_WHITE);
                display.print(F("TIME"));
                display.setCursor(29, 33);
                display.setTextSize(3);
                display.setTextColor(SSD1306_WHITE);
                display.print(F(" UP"));
                display.display();
              } else {
                display.clearDisplay();
                display.display();
              }
              if (millis() - content_timer >= 5000) {
                sh_content = 0;
                content_type = 0;
              }
            }
          }
          break;
        case 3:
          if (st_tm_start) {
            if (millis() - content_timer >= 1000) {
              content_timer = millis();
              sts++;
              if (sts == 60) {
                sts = 0;
                stm++;
                if (stm == 60) {
                  stm = 0;
                  sth++;
                }
              }
            }
          }
          displayContent();
          break;
      }
    } else {
      if (show_time_on_standby) {
        display.clearDisplay();
        display.setCursor(6, 18);
        display.setTextSize(4);
        display.setTextColor(SSD1306_WHITE);
        if (th < 10) {
          display.print(" ");
        }
        display.print(th);
        display.print(":");
        if (tm < 10) {
          display.print("0");
        }
        display.print(tm);
        display.display();
        if (!added && ts >= 45 && millis() - live_time >= 15000 - (ts - 45) * 1000) {
          tm++;
          added = 1;
        }
      } else {
        display.clearDisplay();
        display.display();
      }
    }
  } else {
    display.clearDisplay();
    display.setCursor(0, 17);
    display.setTextSize(2);
    display.setTextColor(SSD1306_WHITE);
    display.print(F("Connecting\n   "));
    for (uint8_t i = 0; i < (millis() - live_time) / 1000 % 5; i++) {
      display.print(F("."));
    }
    display.display();
  }
}

void displayContent() {
  if (sh_content) {
    switch (content_type) {
      case 1:
        display.clearDisplay();

        display.drawBitmap(0, (SCREEN_HEIGHT - LOGO_SIZE) / 2, app_logos[appIndex], LOGO_SIZE, LOGO_SIZE, 1);

        display.setCursor(0, 0);
        display.setTextSize(2);
        display.setTextColor(SSD1306_WHITE);
        display.print(title);

        if (overlap) {
          display.fillRect(121, 12, 2, 2, SSD1306_INVERSE);
          display.fillRect(126, 12, 2, 2, SSD1306_INVERSE);
        }

        display.setCursor(LOGO_SIZE + 5, 16);
        display.setTextSize(1);
        display.println(value_pointer);

        display.display();
        break;
      case 2:
      case 3:
        if (sth > 0) {
          display.clearDisplay();
          display.setCursor(5, 21);
          display.setTextSize(3);
          display.setTextColor(SSD1306_WHITE);
          if (sth < 10) {
            display.print(F(" "));
          }
          display.print(sth);

          display.fillRect(41, 27, 3, 3, SSD1306_WHITE);
          display.fillRect(41, 33, 3, 3, SSD1306_WHITE);

          display.setCursor(47, 21);
          display.setTextSize(3);
          display.setTextColor(SSD1306_WHITE);
          if (stm < 10) {
            display.print(F("0"));
          }
          display.print(stm);

          display.fillRect(83, 27, 3, 3, SSD1306_WHITE);
          display.fillRect(83, 33, 3, 3, SSD1306_WHITE);

          display.setCursor(89, 21);
          display.setTextSize(3);
          display.setTextColor(SSD1306_WHITE);
          if (sts < 10) {
            display.print(F("0"));
          }
          display.print(sts);
          display.display();
        } else {
          display.clearDisplay();
          display.setCursor(26, 21);
          display.setTextSize(3);
          display.setTextColor(SSD1306_WHITE);
          if (stm < 10) {
            display.print(F(" "));
          }
          display.print(stm);

          display.fillRect(62, 27, 3, 3, SSD1306_WHITE);
          display.fillRect(62, 33, 3, 3, SSD1306_WHITE);

          display.setCursor(68, 21);
          display.setTextSize(3);
          display.setTextColor(SSD1306_WHITE);
          if (sts < 10) {
            display.print(F("0"));
          }
          display.print(sts);
          display.display();
        }
        break;
    }
  }
}